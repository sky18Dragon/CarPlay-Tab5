## components/airplay_software_provider/Kconfig
```kconfig
menu "Wired AirPlay"
config AIRPLAY_PAIRING_CODE
    string "Pair-Setup code"
    default "3939"
endmenu
```

## main/Kconfig.projbuild
```kconfig
menu "CarPlay Tab5"

config TAB5_VIDEO_PROFILE_HEIGHT
    int "Requested CarPlay video height (192, 240, 288, 360, 384, 480 or 576)"
    default 240
    help
        A new value starts one trial. If the stream cannot keep up, or the trial
        ends before it is judged, the firmware returns to 1024x192.

config TAB5_IAP2_NCM_INTERFACE
    int "Verified phone NCM control interface (-1 = unconfigured)"
    range -1 255
    default -1
    help
        Identification profile for the intended iPhone USB NCM configuration.
        Must be established from descriptors; the S3 default is not assumed.

endmenu
```
