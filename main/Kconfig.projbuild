## main/Kconfig.projbuild
```kconfig
menu "CarPlay Tab5"

config TAB5_VIDEO_PROFILE_HEIGHT
    int "Requested CarPlay video height (192, 240, 288, 360, 384, 480 or 576)"
    default 240
    help
        A new value starts one trial. If the stream cannot keep up, or the trial
        ends before it is judged, the firmware returns to 1024x192.

config TAB5_IAP2_NCM_INTERFACE
    int "Verified phone NCM control interface (-1 = unconfigured)"
    range -1 255
    default -1
    help
        Identification profile for the intended iPhone USB NCM configuration.
        Must be established from descriptors; the S3 default is not assumed.

choice TAB5_ECHO
    prompt "Echo cancellation for phone calls"
    default TAB5_ECHO_ESPSR
    help
        Removes the Tab5 speaker's sound from the microphone during calls, so the
        other person does not hear themselves.

    config TAB5_ECHO_ESPSR
        bool "Espressif ESP-SR (best quality; closed binaries, Espressif licence)"
        help
            Full-duplex echo canceller from espressif/esp-sr. Its libraries are
            binary-only under the Espressif licence, so this build cannot be
            distributed under the GPL alone. Use SpeexDSP for shareable builds.

    config TAB5_ECHO_SPEEX
        bool "SpeexDSP (open source, BSD; can be shared with the GPL source)"

    config TAB5_ECHO_NONE
        bool "None"
endchoice

endmenu
```
